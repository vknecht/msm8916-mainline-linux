## Documentation/devicetree/bindings/power/supply/smb1360.yaml
```yaml
# SPDX-License-Identifier: (GPL-2.0-only OR BSD-2-Clause)
%YAML 1.2
---
$id: "http://devicetree.org/schemas/power/supply/smb1360.yaml#"
$schema: "http://devicetree.org/meta-schemas/core.yaml#"

title: Qualcomm SMB1360 charger and fuel gauge

maintainers:
  - Jonathan Albrieux <jonathan.albrieux@gmail.com>

description: |
  Port for Qualcomm SMB1360 charger and fuel gauge downstream driver.

  A brief overview of the chip can be found at:
    https://www.qualcomm.com/products/quick-charge-10

  Original code can be found at:
    https://github.com/msm8916-mainline/android_kernel_qcom_msm8916/blob/master/drivers/power/smb1360-charger-fg.c

properties:
  compatible:
    enum:
      - qcom,smb1360

  reg:
    description: I2C address of the charger.

  interrupts:
    description:
      IRQ number of the GPIO connected to the STAT pin.

  io-channels:
    description:
      Specify the IIO ADC channels to get battery id.

  io-channel-names:
    description:
      Channel name used to get the battery id.

  qcom,fg-batt-capacity-mah:
    $ref: /schemas/types.yaml#/definitions/uint32
    description:
      The new battery capacity to be supported.
      This updates the ACTUAL and NOMINAL CAPACITY of the profile.

  qcom,fg-cutoff-voltage-mv:
    $ref: /schemas/types.yaml#/definitions/uint32
    description:
      This is the minimum allowed system voltage. The FG will report
      SOC = 0 at this volatge. This value is in mV.

  qcom,fg-ibatt-standby-ma:
    $ref: /schemas/types.yaml#/definitions/uint32
    description:
      This is the minimum current value for the SOC to be above 0% at
      the cutoff voltage. This value is in mA.

  qcom,fg-cc-to-cv-mv:
    $ref: /schemas/types.yaml#/definitions/uint32
    description:
      This is the voltage at which the FG transitions from CC to CV.
      This value should never be higher than the float voltage. This
      value is in mV.

  qcom,thermistor-c1-coeff:
    $ref: /schemas/types.yaml#/definitions/uint32
    description:
      This is the NTC thermistor C1 coeff for the thermistor inside
      the battery. This value is 16-bit float encoded value determined from the
      NTC-c1_coeff mapping.

  qcom,fg-auto-recharge-soc:
    $ref: /schemas/types.yaml#/definitions/uint32
    description:
      Defines the auto recharging SOC threshold.

  qcom,fg-iterm-ma:
    $ref: /schemas/types.yaml#/definitions/uint32
    description:
      This is termination current at which the Monotonic SOC reports 100.
      The value passed here is negated in the driver (assuming that the iterm
      is always -ve). This value is in mA.

  qcom,float-voltage-mv:
    $ref: /schemas/types.yaml#/definitions/uint32
    description:
      The maximum voltage up to which the battery is charged.
      This value is in mV.

  qcom,charging-timeout:
    $ref: /schemas/types.yaml#/definitions/uint32
    description:
      Maximum duration in minutes that a single charge cycle may last.
      Supported values are 0, 192, 384, 768, and 1536. A value of 0 means that
      no charge cycle timeout is used and charging can continue indefinitely.

  qcom,recharge-thresh-mv:
    $ref: /schemas/types.yaml#/definitions/uint32
    description:
      Specifies the minimum voltage drop in millivolts below the float voltage
      that is required in order to initiate a new charging cycle.
      Supported values are 50, 100, 200 and 300mV.

  qcom,iterm-ma:
    $ref: /schemas/types.yaml#/definitions/uint32
    description:
      Specifies the termination current to indicate end-of-charge.
      Possible values in 25, 50, 75, 100, 125, 150, 175 and 200mA

  qcom,chg-inhibit-disabled:
    type: boolean
    description:
      Disables the charger-inhibit function.

  qcom,shdn-after-pwroff:
    type: boolean
    description:
      Configure smb1360 for shutdown at power-off.

  qcom,fg-reset-at-pon:
    type: boolean
    description:
      Indicates if the FG reset at power-on is enabled.

  qcom,fg-reset-threshold-mv:
    $ref: /schemas/types.yaml#/definitions/uint32
    description:
      Indicates the volatge threshold to reset the FG. It is compared against
      the difference between in predicted voltage and current voltage.
      If this value is not specified a default value of 50mV is used.
      Unit is in milli-volts.

  qcom,batt-profile-select:
    type: boolean
    description:
      Indicates battery-profile selection is enabled.

  qcom,batt-id-vref-uv:
    $ref: /schemas/types.yaml#/definitions/uint32
    description:
      The reference voltage on the battery-ID line specified in micro-volts.

  qcom,batt-id-rpullup-kohm:
    $ref: /schemas/types.yaml#/definitions/uint32
    description:
      The pull-up resistor connected on the battery-ID (vref) line.

  qcom,profile-a-rid-kohm:
    $ref: /schemas/types.yaml#/definitions/uint32
    description:
      The battery-ID resistor (RID) in Kohm supported by profile-A of SMB1360.
      This should be specified if 'batt-profile-select' is defined.

  qcom,profile-b-rid-kohm:
    $ref: /schemas/types.yaml#/definitions/uint32
    description:
      The battery-ID resistor (RID) in Kohm supported by profile-B of SMB1360.
      This should be specified if 'batt-profile-select' is defined.

  qcom,rsense-10mhom:
    type: boolean
    description:
      Indicates the Rsense resistor configuration.
      If set, the Rsense is 10mOhm else its 20mOhm.

  qcom,otp-hard-jeita-config:
    type: boolean
    description:
      Indicates if cold and hot thresholds need be modified.
      If it's not defined, default temp thresholds [0, 55] will be used.

  qcom,otp-hot-bat-decidegc:
    $ref: /schemas/types.yaml#/definitions/uint32
    description:
      Hot battery temperature in decidegC.

  qcom,otp-cold-bat-decidegc:
    $ref: /schemas/types.yaml#/definitions/uint32
    description:
      Cold battery temperature in decidegC.

  qcom,otg-batt-curr-limit:
    $ref: /schemas/types.yaml#/definitions/uint32
    description:
      This property defines the current threshold draw
      from battery when device working at OTG mode.
      The possible values are 350, 550, 950, 1500mA.

  usb_otg_vbus:
    description: Regulator controlling USB OTG VBUS.

dependencies:
  qcom,otp-hard-jeita-config: [ 'qcom,otp-hot-bat-decidegc', 'qcom,otp-cold-bat-decidegc' ]
  qcom,otp-hot-bat-decidegc: [ 'qcom,otp-hard-jeita-config' ]
  qcom,otp-cold-bat-decidegc: [ 'qcom,otp-hard-jeita-config' ]

required:
  - compatible
  - reg

additionalProperties: true

examples:
  - |
    #include <dt-bindings/interrupt-controller/irq.h>
    #include <dt-bindings/iio/qcom,spmi-vadc.h>

    i2c {
      #address-cells = <1>;
      #size-cells = <0>;

      charger: battery@14 {
        compatible = "qcom,smb1360";
        reg = <0x14>;

        interrupt-parent = <&msmgpio>;
        interrupts = <62 IRQ_TYPE_LEVEL_LOW>;

        io-channels = <&pm8916_vadc VADC_LR_MUX2_BAT_ID>;
        io-channel-names = "batt-id";

        pinctrl-names = "default";
        pinctrl-0 = <&smb_int_default>;

        qcom,fg-batt-capacity-mah = <2810>;
        qcom,fg-cutoff-voltage-mv = <3400>;
        qcom,fg-ibatt-standby-ma = <200>;
        qcom,fg-cc-to-cv-mv = <4397>;
        qcom,fg-iterm-ma = <100>;
        qcom,thermistor-c1-coeff = <0x86C2>;
        qcom,fg-auto-recharge-soc = <97>;
        qcom,float-voltage-mv = <4400>;
        qcom,charging-timeout = <768>;
        qcom,recharge-thresh-mv = <50>;
        qcom,iterm-ma = <100>;
        qcom,chg-inhibit-disabled;

        qcom,shdn-after-pwroff;
        qcom,fg-reset-at-pon;
        qcom,fg-reset-threshold-mv = <200>;

        qcom,batt-profile-select;
        qcom,batt-id-vref-uv = <1800000>;
        qcom,batt-id-rpullup-kohm = <100>;
        qcom,profile-a-rid-kohm = <100>;
        qcom,profile-b-rid-kohm = <200>;
        qcom,rsense-10mhom;

        qcom,otp-hard-jeita-config;
        qcom,otp-hot-bat-decidegc = <500>;
        qcom,otp-cold-bat-decidegc = <(-50)>;

        qcom,otg-batt-curr-limit = <1500>;
        usb_otg_vbus: usb-otg-vbus {};
      };
    };
```

## arch/arm64/configs/msm8939_defconfig
```kconfig
# CONFIG_LOCALVERSION_AUTO is not set
CONFIG_SYSVIPC=y
CONFIG_POSIX_MQUEUE=y
CONFIG_AUDIT=y
CONFIG_NO_HZ_IDLE=y
CONFIG_HIGH_RES_TIMERS=y
CONFIG_BPF_JIT=y
CONFIG_PREEMPT=y
CONFIG_IRQ_TIME_ACCOUNTING=y
CONFIG_BSD_PROCESS_ACCT=y
CONFIG_BSD_PROCESS_ACCT_V3=y
CONFIG_IKCONFIG=y
CONFIG_IKCONFIG_PROC=y
CONFIG_NUMA_BALANCING=y
CONFIG_MEMCG=y
CONFIG_BLK_CGROUP=y
CONFIG_CGROUP_PIDS=y
CONFIG_CGROUP_HUGETLB=y
CONFIG_CPUSETS=y
CONFIG_CGROUP_DEVICE=y
CONFIG_CGROUP_CPUACCT=y
CONFIG_CGROUP_PERF=y
CONFIG_USER_NS=y
CONFIG_SCHED_AUTOGROUP=y
CONFIG_BLK_DEV_INITRD=y
CONFIG_KALLSYMS_ALL=y
# CONFIG_COMPAT_BRK is not set
CONFIG_PROFILING=y
CONFIG_ARCH_QCOM=y
CONFIG_ARM64_VA_BITS_48=y
CONFIG_SCHED_MC=y
CONFIG_NUMA=y
CONFIG_KEXEC=y
CONFIG_CRASH_DUMP=y
CONFIG_COMPAT=y
CONFIG_RANDOMIZE_BASE=y
CONFIG_HIBERNATION=y
CONFIG_WQ_POWER_EFFICIENT_DEFAULT=y
CONFIG_ENERGY_MODEL=y
CONFIG_CPU_FREQ=y
CONFIG_CPU_FREQ_STAT=y
CONFIG_CPU_FREQ_GOV_POWERSAVE=y
CONFIG_CPU_FREQ_GOV_USERSPACE=y
CONFIG_CPU_FREQ_GOV_ONDEMAND=y
CONFIG_CPU_FREQ_GOV_CONSERVATIVE=y
CONFIG_CPUFREQ_DT=y
CONFIG_ARM_QCOM_CPUFREQ_NVMEM=y
CONFIG_ARM_QCOM_CPUFREQ_HW=y
CONFIG_ARM64_CRYPTO=y
CONFIG_CRYPTO_SHA1_ARM64_CE=y
CONFIG_CRYPTO_SHA2_ARM64_CE=y
CONFIG_CRYPTO_GHASH_ARM64_CE=y
CONFIG_CRYPTO_AES_ARM64_CE_CCM=y
CONFIG_CRYPTO_AES_ARM64_CE_BLK=y
CONFIG_JUMP_LABEL=y
CONFIG_MODULES=y
CONFIG_MODULE_UNLOAD=y
# CONFIG_CORE_DUMP_DEFAULT_ELF_HEADERS is not set
CONFIG_KSM=y
CONFIG_MEMORY_FAILURE=y
CONFIG_TRANSPARENT_HUGEPAGE=y
CONFIG_NET=y
CONFIG_PACKET=y
CONFIG_UNIX=y
CONFIG_INET=y
CONFIG_IP_MULTICAST=y
CONFIG_IP_PNP=y
CONFIG_IP_PNP_DHCP=y
CONFIG_IP_PNP_BOOTP=y
CONFIG_NETFILTER=y
CONFIG_DNS_RESOLVER=y
CONFIG_QRTR=m
CONFIG_QRTR_SMD=m
CONFIG_BT=m
CONFIG_BT_RFCOMM=m
CONFIG_BT_RFCOMM_TTY=y
CONFIG_BT_HIDP=m
# CONFIG_BT_LE is not set
CONFIG_BT_LEDS=y
# CONFIG_BT_DEBUGFS is not set
CONFIG_BT_HCIBTUSB=m
CONFIG_BT_HCIUART=m
CONFIG_BT_HCIUART_LL=y
CONFIG_BT_HCIUART_BCM=y
CONFIG_BT_HCIUART_QCA=y
CONFIG_BT_QCOMSMD=m
CONFIG_CFG80211=m
CONFIG_CFG80211_WEXT=y
CONFIG_MAC80211=m
CONFIG_MAC80211_LEDS=y
CONFIG_RFKILL=m
CONFIG_NET_9P=y
CONFIG_NET_9P_VIRTIO=y
CONFIG_DEVTMPFS=y
CONFIG_DEVTMPFS_MOUNT=y
CONFIG_BRCMSTB_GISB_ARB=y
CONFIG_SIMPLE_PM_BUS=y
CONFIG_VEXPRESS_CONFIG=y
CONFIG_MTD=y
CONFIG_MTD_BLOCK=y
CONFIG_MTD_RAW_NAND=y
CONFIG_MTD_NAND_DENALI_DT=y
CONFIG_MTD_NAND_QCOM=y
CONFIG_MTD_SPI_NOR=y
CONFIG_BLK_DEV_LOOP=y
CONFIG_QCOM_COINCELL=y
CONFIG_SRAM=y
CONFIG_NETDEVICES=y
CONFIG_TUN=y
CONFIG_WCN36XX=m
CONFIG_INPUT_EVDEV=y
CONFIG_KEYBOARD_GPIO=y
CONFIG_INPUT_TOUCHSCREEN=y
CONFIG_INPUT_MISC=y
CONFIG_INPUT_PM8941_PWRKEY=y
# CONFIG_SERIO_SERPORT is not set
CONFIG_SERIAL_MSM=y
CONFIG_SERIAL_MSM_CONSOLE=y
CONFIG_SERIAL_DEV_BUS=y
CONFIG_I2C_CHARDEV=y
CONFIG_I2C_QUP=y
CONFIG_SPI=y
CONFIG_SPI_CADENCE_QUADSPI=y
CONFIG_SPI_QUP=y
CONFIG_SPMI=y
CONFIG_PINCTRL_SINGLE=y
CONFIG_PINCTRL_MSM=y
CONFIG_PINCTRL_MSM8916=y
CONFIG_PINCTRL_QCOM_SPMI_PMIC=y
CONFIG_POWER_RESET_MSM=y
CONFIG_POWER_RESET_QCOM_PON=y
CONFIG_POWER_RESET_XGENE=y
CONFIG_POWER_RESET_SYSCON=y
CONFIG_SYSCON_REBOOT_MODE=y
CONFIG_BATTERY_BQ27XXX=y
CONFIG_WATCHDOG=y
CONFIG_MFD_SPMI_PMIC=y
CONFIG_REGULATOR_FIXED_VOLTAGE=y
CONFIG_REGULATOR_GPIO=y
CONFIG_REGULATOR_PWM=y
CONFIG_REGULATOR_QCOM_SMD_RPM=y
CONFIG_REGULATOR_QCOM_SPMI=y
CONFIG_DRM=y
CONFIG_DRM_MSM=m
CONFIG_DRM_PANEL_SONY_TULIP_TRULY_NT35521=m
CONFIG_FB=y
CONFIG_BACKLIGHT_CLASS_DEVICE=y
CONFIG_BACKLIGHT_PWM=y
CONFIG_BACKLIGHT_GPIO=y
CONFIG_LOGO=y
CONFIG_SOUND=y
CONFIG_SND=y
CONFIG_SND_DYNAMIC_MINORS=y
CONFIG_SND_SOC=y
CONFIG_SND_SOC_QCOM=y
CONFIG_SND_SOC_MSM8916_WCD_ANALOG=y
CONFIG_SND_SOC_MSM8916_WCD_DIGITAL=y
CONFIG_USB=y
CONFIG_USB_OTG=y
CONFIG_USB_XHCI_HCD=y
CONFIG_USB_EHCI_HCD=y
CONFIG_USB_EHCI_HCD_PLATFORM=y
CONFIG_USB_OHCI_HCD=y
CONFIG_USB_OHCI_HCD_PLATFORM=y
CONFIG_USB_PRINTER=y
CONFIG_USB_CHIPIDEA=y
CONFIG_USB_CHIPIDEA_UDC=y
CONFIG_USB_CHIPIDEA_HOST=y
CONFIG_USB_HUB_USB251XB=y
CONFIG_NOP_USB_XCEIV=y
CONFIG_USB_ULPI=y
CONFIG_USB_GADGET=y
CONFIG_U_SERIAL_CONSOLE=y
CONFIG_USB_SNP_UDC_PLAT=y
CONFIG_USB_BDC_UDC=y
CONFIG_USB_CONFIGFS=y
CONFIG_USB_CONFIGFS_ACM=y
CONFIG_USB_CONFIGFS_NCM=y
CONFIG_USB_CONFIGFS_ECM=y
CONFIG_USB_CONFIGFS_ECM_SUBSET=y
CONFIG_USB_CONFIGFS_RNDIS=y
CONFIG_USB_CONFIGFS_EEM=y
CONFIG_USB_CDC_COMPOSITE=y
CONFIG_TYPEC=y
CONFIG_TYPEC_TPS6598X=y
CONFIG_MMC=y
CONFIG_MMC_BLOCK_MINORS=32
CONFIG_MMC_SDHCI=y
CONFIG_MMC_SDHCI_PLTFM=y
CONFIG_MMC_SDHCI_MSM=y
CONFIG_NEW_LEDS=y
CONFIG_LEDS_CLASS=y
CONFIG_LEDS_GPIO=y
CONFIG_LEDS_PWM=y
CONFIG_LEDS_SYSCON=y
CONFIG_RTC_CLASS=y
CONFIG_RTC_DRV_PM8XXX=y
CONFIG_DMADEVICES=y
CONFIG_MV_XOR_V2=y
CONFIG_QCOM_BAM_DMA=y
CONFIG_QCOM_HIDMA_MGMT=y
CONFIG_QCOM_HIDMA=y
CONFIG_COMMON_CLK_QCOM=y
CONFIG_QCOM_A53PLL=y
CONFIG_QCOM_CLK_APCS_MSM8916=y
CONFIG_QCOM_CLK_SMD_RPM=y
CONFIG_MSM_GCC_8916=y
CONFIG_MSM_GCC_8939=y
CONFIG_HWSPINLOCK=y
CONFIG_HWSPINLOCK_QCOM=y
CONFIG_MAILBOX=y
CONFIG_QCOM_APCS_IPC=y
CONFIG_ARM_SMMU=y
CONFIG_ARM_SMMU_V3=y
CONFIG_QCOM_IOMMU=y
CONFIG_REMOTEPROC=y
CONFIG_QCOM_Q6V5_MSS=m
CONFIG_QCOM_Q6V5_PAS=m
CONFIG_QCOM_SYSMON=m
CONFIG_QCOM_WCNSS_PIL=m
CONFIG_RPMSG_QCOM_GLINK_RPM=y
CONFIG_RPMSG_QCOM_GLINK_SMEM=m
CONFIG_RPMSG_QCOM_SMD=y
CONFIG_SOC_BRCMSTB=y
CONFIG_QCOM_AOSS_QMP=y
CONFIG_QCOM_CPR=y
CONFIG_QCOM_GENI_SE=y
CONFIG_QCOM_RMTFS_MEM=m
CONFIG_QCOM_RPMH=y
CONFIG_QCOM_RPMPD=y
CONFIG_QCOM_SMEM=y
CONFIG_QCOM_SMD_RPM=y
CONFIG_QCOM_SMP2P=y
CONFIG_QCOM_SMSM=y
CONFIG_QCOM_SOCINFO=y
CONFIG_QCOM_WCNSS_CTRL=m
CONFIG_SOC_TI=y
CONFIG_EXTCON_USB_GPIO=y
CONFIG_IIO=y
CONFIG_QCOM_SPMI_VADC=y
CONFIG_PWM=y
CONFIG_PHY_QCOM_USB_HS=y
CONFIG_QCOM_QFPROM=y
CONFIG_INTERCONNECT=y
CONFIG_INTERCONNECT_QCOM=y
CONFIG_EXT2_FS=y
CONFIG_EXT3_FS=y
CONFIG_EXT4_FS_POSIX_ACL=y
CONFIG_FANOTIFY=y
CONFIG_FANOTIFY_ACCESS_PERMISSIONS=y
CONFIG_QUOTA=y
CONFIG_AUTOFS4_FS=y
CONFIG_VFAT_FS=y
CONFIG_HUGETLBFS=y
CONFIG_EFIVAR_FS=y
CONFIG_SQUASHFS=y
CONFIG_PSTORE=y
CONFIG_PSTORE_CONSOLE=y
CONFIG_PSTORE_RAM=y
CONFIG_NFS_FS=y
CONFIG_NLS_CODEPAGE_437=y
CONFIG_NLS_ISO8859_1=y
CONFIG_SECURITY=y
CONFIG_CRYPTO_ECHAINIV=y
CONFIG_CRYPTO_ANSI_CPRNG=y
CONFIG_CRYPTO_USER_API_RNG=m
CONFIG_CRYPTO_DEV_QCOM_RNG=m
CONFIG_CRYPTO_DEV_AMLOGIC_GXL=y
CONFIG_INDIRECT_PIO=y
CONFIG_CRC_CCITT=m
CONFIG_PRINTK_TIME=y
CONFIG_MAGIC_SYSRQ=y
CONFIG_DEBUG_FS=y
CONFIG_DEBUG_KERNEL=y
CONFIG_PANIC_TIMEOUT=5
# CONFIG_SCHED_DEBUG is not set
# CONFIG_DEBUG_PREEMPT is not set
# CONFIG_FTRACE is not set
CONFIG_MEMTEST=y
```
